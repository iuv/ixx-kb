## Kconfig.defconfig
```kconfig
if SHIELD_IXX_LEFT

config ZMK_KEYBOARD_NAME
    default "ixx-kb"

config ZMK_SPLIT_ROLE_CENTRAL
    default y

endif

if SHIELD_IXX_LEFT || SHIELD_IXX_RIGHT

config ZMK_SPLIT
    default y

endif
```

## Kconfig.shield
```kconfig
# Copyright (c) 2020 The ZMK Contributors
# SPDX-License-Identifier: MIT

config SHIELD_IXX_LEFT
    def_bool $(shields_list_contains,ixx_left)

config SHIELD_IXX_RIGHT
    def_bool $(shields_list_contains,ixx_right)
```
